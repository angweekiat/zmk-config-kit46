## boards/shields/kit46/Kconfig.defconfig
```kconfig
if SHIELD_KIT46_LEFT

config ZMK_KEYBOARD_NAME
    default "Kit46"

config ZMK_SPLIT_ROLE_CENTRAL
    default y

endif

if SHIELD_KIT46_LEFT || SHIELD_KIT46_RIGHT

config ZMK_SPLIT
    default y

endif
```

## boards/shields/kit46/Kconfig.shield
```kconfig
config SHIELD_KIT46_LEFT
    def_bool $(shields_list_contains,kit46_left)

config SHIELD_KIT46_RIGHT
    def_bool $(shields_list_contains,kit46_right)
```
